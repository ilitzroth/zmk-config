## boards/arm/corne_choc_pro_il/Kconfig.board
```kconfig
# Copyright (c) 2020 The ZMK Contributors
# SPDX-License-Identifier: MIT

config BOARD_CORNE_CHOC_PRO_IL_LEFT
	bool "Corne Choc Pro IL Left"
	depends on SOC_NRF52840_QIAA

config BOARD_CORNE_CHOC_PRO_IL_RIGHT
    bool "Corne Choc Pro IL Right"
    depends on SOC_NRF52840_QIAA
```

## boards/arm/piantor_pro_bt_il/Kconfig.board
```kconfig
# Copyright (c) 2020 The ZMK Contributors
# SPDX-License-Identifier: MIT

config BOARD_PIANTOR_PRO_BT_IL_LEFT
	bool "Piantor Pro BT IL Left"
	depends on SOC_NRF52840_QIAA

config BOARD_PIANTOR_PRO_BT_IL_RIGHT
    bool "Piantor Pro BT IL Right"
    depends on SOC_NRF52840_QIAA
```
